## sdkconfig.defaults
```kconfig
CONFIG_APP_REPRODUCIBLE_BUILD=y

CONFIG_FATFS_VOLUME_COUNT=2
CONFIG_FATFS_LFN_STACK=y
CONFIG_FATFS_SECTOR_4096=y
CONFIG_FATFS_CODEPAGE_437=y
CONFIG_FATFS_MAX_LFN=255
# CONFIG_FATFS_PER_FILE_CACHE is not set
CONFIG_FATFS_ALLOC_PREFER_EXTRAM=y
CONFIG_FATFS_IMMEDIATE_FSYNC=y
CONFIG_FATFS_USE_LABEL=y

CONFIG_ESP_NETIF_TCPIP_LWIP=n
CONFIG_ESP_NETIF_LOOPBACK=n
CONFIG_ESP_NETIF_USES_TCPIP_WITH_BSD_API=n
CONFIG_ESP_NETIF_REPORT_DATA_TRAFFIC=n

CONFIG_TINYUSB_DEBUG_LEVEL=1
CONFIG_TINYUSB_MSC_ENABLED=y
CONFIG_TINYUSB_MSC_BUFSIZE=4096
CONFIG_TINYUSB_MSC_MOUNT_PATH="/data"
CONFIG_TINYUSB_DFU_MODE_DFU=y
CONFIG_TINYUSB_DFU_BUFSIZE=1024

# CONFIG_SPI_SLAVE_ISR_IN_IRAM is not set

# CONFIG_ESP_ERR_TO_NAME_LOOKUP is not set

CONFIG_FREERTOS_HZ=200
CONFIG_FREERTOS_CHECK_STACKOVERFLOW_NONE=y
CONFIG_FREERTOS_USE_TICK_HOOK=y
CONFIG_FREERTOS_TIMER_TASK_PRIORITY=3
CONFIG_FREERTOS_TIMER_TASK_STACK_DEPTH=4096
# CONFIG_FREERTOS_USE_STATS_FORMATTING_FUNCTIONS is not set
CONFIG_FREERTOS_USE_TICKLESS_IDLE=y
CONFIG_FREERTOS_IDLE_TIME_BEFORE_SLEEP=3
# CONFIG_FREERTOS_TLSP_DELETION_CALLBACKS is not set
CONFIG_FREERTOS_PLACE_FUNCTIONS_INTO_FLASH=y
CONFIG_FREERTOS_DEBUG_OCDAWARE=n
CONFIG_FREERTOS_TASK_NOTIFICATION_ARRAY_ENTRIES=2

CONFIG_LOG_COLORS=y

CONFIG_LIBC_NEWLIB_NANO_FORMAT=y

# CONFIG_SPI_FLASH_ENABLE_ENCRYPTED_READ_WRITE is not set

# CONFIG_VFS_SUPPORT_SELECT is not set
# CONFIG_VFS_SUPPORT_TERMIOS is not set

CONFIG_IDF_EXPERIMENTAL_FEATURES=y

CONFIG_COMPILER_OPTIMIZATION_PERF=y
CONFIG_COMPILER_OPTIMIZATION_ASSERTIONS_DISABLE=y
CONFIG_COMPILER_OPTIMIZATION_ASSERTION_LEVEL=0
CONFIG_COMPILER_ASSERT_NDEBUG_EVALUATE=n
CONFIG_COMPILER_WARN_WRITE_STRINGS=y

#CONFIG_ESP_SYSTEM_PANIC_PRINT_HALT is not set
# CONFIG_ESP_SYSTEM_PANIC_GDBSTUB is not set
CONFIG_ESP_SYSTEM_PANIC_REBOOT_DELAY_SECONDS=10

CONFIG_ESP_SYSTEM_EVENT_QUEUE_SIZE=16
CONFIG_ESP_SYSTEM_EVENT_TASK_STACK_SIZE=0
CONFIG_ESP_MAIN_TASK_STACK_SIZE=3000
# CONFIG_ESP_INT_WDT is not set
CONFIG_ESP_TASK_WDT_CHECK_IDLE_TASK_CPU1=n

CONFIG_HEAP_ABORT_WHEN_ALLOCATION_FAILS=y

CONFIG_LV_CONF_SKIP=n
```

## sdkconfig.defaults.1_28
```kconfig
CONFIG_SPIRAM=y
CONFIG_SPIRAM_MODE_QUAD=y
CONFIG_SPIRAM_TYPE_AUTO=y
CONFIG_SPIRAM_SPEED_120M=y
CONFIG_SPIRAM_BOOT_INIT=y
CONFIG_SPIRAM_MALLOC_RESERVE_INTERNAL=16384

CONFIG_ESPTOOLPY_FLASHSIZE_4MB=y

CONFIG_TINYUSB_CDC_ENABLED=y
CONFIG_TINYUSB_CDC_COUNT=1
CONFIG_TINYUSB_CDC_RX_BUFSIZE=512
CONFIG_TINYUSB_CDC_TX_BUFSIZE=512
CONFIG_TINYUSB_CDC_EP_BUFSIZE=512

#
# Power Management
#
CONFIG_PM_ENABLE=y
# CONFIG_PM_DFS_INIT_AUTO is not set
CONFIG_PM_PROFILING=y
# CONFIG_PM_TRACE is not set
# CONFIG_PM_SLP_IRAM_OPT is not set
# CONFIG_PM_RTOS_IDLE_OPT is not set
CONFIG_PM_SLP_DISABLE_GPIO=y
CONFIG_PM_LIGHTSLEEP_RTC_OSC_CAL_INTERVAL=1
# CONFIG_PM_POWER_DOWN_CPU_IN_LIGHT_SLEEP is not set
# CONFIG_PM_LIGHT_SLEEP_CALLBACKS is not set
# end of Power Management
```

## sdkconfig.defaults.2_1
```kconfig
CONFIG_SPI_FLASH_ROM_IMPL=y
# CONFIG_SPI_MASTER_IN_IRAM is not set
# CONFIG_SPI_MASTER_ISR_IN_IRAM is not set

# CONFIG_GDMA_CTRL_FUNC_IN_IRAM is not set

CONFIG_I2C_MASTER_ISR_HANDLER_IN_IRAM is not set

CONFIG_ESP_EVENT_POST_FROM_ISR is not set
# CONFIG_POST_EVENTS_FROM_ISR is not set

CONFIG_SPIRAM=y
CONFIG_SPIRAM_MODE_OCT=y
CONFIG_SPIRAM_TYPE_AUTO=y
CONFIG_SPIRAM_XIP_FROM_PSRAM=y
CONFIG_SPIRAM_SPEED_120M=y
CONFIG_SPIRAM_MALLOC_ALWAYSINTERNAL=8192
CONFIG_SPIRAM_TRY_ALLOCATE_WIFI_LWIP=y
CONFIG_SPIRAM_MALLOC_RESERVE_INTERNAL=8192

CONFIG_ESPTOOLPY_FLASHSIZE_8MB=y

CONFIG_NVS_ALLOCATE_CACHE_IN_SPIRAM=y

# CONFIG_SD_ENABLE_SDIO_SUPPORT is not set
```

## sdkconfig.defaults.esp32s3
```kconfig
CONFIG_APP_NO_BLOBS=y

CONFIG_APP_RETRIEVE_LEN_ELF_SHA=16

CONFIG_ESPTOOLPY_FLASHMODE_QIO=y
CONFIG_ESPTOOLPY_FLASHFREQ_120M=y

# CONFIG_PARTITION_TABLE_SINGLE_APP is not set
CONFIG_PARTITION_TABLE_TWO_OTA=y
CONFIG_PARTITION_TABLE_FILENAME="partitions_two_ota.csv"

CONFIG_ESP_SLEEP_PSRAM_LEAKAGE_WORKAROUND=y
# CONFIG_ESP_SLEEP_GPIO_RESET_WORKAROUND is not set
# CONFIG_ESP_SLEEP_EVENT_CALLBACKS is not set

CONFIG_ESP_DEFAULT_CPU_FREQ_MHZ_240=y

CONFIG_ESP32S3_INSTRUCTION_CACHE_32KB=y
CONFIG_ESP32S3_INSTRUCTION_CACHE_SIZE=0x8000
CONFIG_ESP32S3_DATA_CACHE_64KB=y
CONFIG_ESP32S3_DATA_CACHE_SIZE=0x10000
CONFIG_ESP32S3_DATA_CACHE_LINE_64B=y
CONFIG_ESP32S3_DATA_CACHE_LINE_SIZE=64

# CONFIG_ESP_SYSTEM_MEMPROT_FEATURE is not set

# CONFIG_MCPWM_ISR_CACHE_SAFE is not set
# CONFIG_PM_POWER_DOWN_CPU_IN_LIGHT_SLEEP is not set

# CONFIG_ESP_INT_WDT is not set
CONFIG_ESP_DEBUG_STUBS_ENABLE=n
CONFIG_ESP_DEBUG_OCDAWARE=n

CONFIG_LIBC_TIME_SYSCALL_USE_HRT=y
```
